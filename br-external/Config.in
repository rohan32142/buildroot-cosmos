## br-external/Config.in
```kconfig
source "$BR2_EXTERNAL_QUT_PATH/package/bitstream-timestamp/Config.in"
source "$BR2_EXTERNAL_QUT_PATH/package/configpl/Config.in"
source "$BR2_EXTERNAL_QUT_PATH/package/philics-telemetry/Config.in"
source "$BR2_EXTERNAL_QUT_PATH/package/cosmos-i2cconfig/Config.in"
source "$BR2_EXTERNAL_QUT_PATH/package/pacpwm-config/Config.in"
source "$BR2_EXTERNAL_QUT_PATH/package/philics-pl/Config.in"
source "$BR2_EXTERNAL_QUT_PATH/package/zrproc/Config.in"
source "$BR2_EXTERNAL_QUT_PATH/package/zrproc-firmware/Config.in"
source "$BR2_EXTERNAL_QUT_PATH/package/zynq-mkbootimage/Config.in.host"
```

## br-external/configs/zynq_cosmos_telemetry_defconfig
```kconfig
BR2_arm=y
BR2_cortex_a9=y
BR2_ARM_ENABLE_NEON=y
BR2_ARM_ENABLE_VFP=y
BR2_PACKAGE_HOST_LINUX_HEADERS_CUSTOM_4_14=y
BR2_GLOBAL_PATCH_DIR="$(BR2_EXTERNAL_QUT_PATH)/board/cosmos/patches"
# BR2_PIC_PIE is not set
BR2_SSP_NONE=y
BR2_RELRO_NONE=y
BR2_FORTIFY_SOURCE_NONE=y
BR2_TARGET_GENERIC_HOSTNAME="cosmos"
BR2_TARGET_GENERIC_ISSUE="Welcome to Buildroot (cosmos-xzq10-qut)"
BR2_TARGET_GENERIC_ROOT_PASSWD="root"
BR2_ROOTFS_USERS_TABLES="$(BR2_EXTERNAL_QUT_PATH)/board/cosmos/users_table.txt"
BR2_ROOTFS_POST_IMAGE_SCRIPT="$(BR2_EXTERNAL_QUT_PATH)/board/cosmos/post-image.sh"
BR2_ROOTFS_POST_SCRIPT_ARGS="$(BR2_EXTERNAL_QUT_PATH)"
BR2_LINUX_KERNEL=y
BR2_LINUX_KERNEL_CUSTOM_TARBALL=y
BR2_LINUX_KERNEL_CUSTOM_TARBALL_LOCATION="https://github.com/enclustra-bsp/xilinx-linux/archive/refs/tags/v1.8.2.tar.gz"
BR2_LINUX_KERNEL_USE_CUSTOM_CONFIG=y
BR2_LINUX_KERNEL_CUSTOM_CONFIG_FILE="$(BR2_EXTERNAL_QUT_PATH)/board/cosmos/kernel.config"
BR2_LINUX_KERNEL_UIMAGE=y
BR2_LINUX_KERNEL_UIMAGE_LOADADDR="0x8000"
BR2_LINUX_KERNEL_DTS_SUPPORT=y
BR2_LINUX_KERNEL_CUSTOM_DTS_PATH="$(BR2_EXTERNAL_QUT_PATH)/board/cosmos/zynq-cosmos-xzq10-qut.dts"
BR2_LINUX_KERNEL_NEEDS_HOST_OPENSSL=y
BR2_PACKAGE_BUSYBOX_CONFIG_FRAGMENT_FILES="$(BR2_EXTERNAL_QUT_PATH)/board/cosmos/busybox-philics.fragment"
BR2_PACKAGE_TCF_AGENT=y
BR2_PACKAGE_DOSFSTOOLS=y
BR2_PACKAGE_DOSFSTOOLS_FATLABEL=y
BR2_PACKAGE_DOSFSTOOLS_FSCK_FAT=y
BR2_PACKAGE_DOSFSTOOLS_MKFS_FAT=y
BR2_PACKAGE_E2TOOLS=y
BR2_PACKAGE_MTD=y
BR2_PACKAGE_MTD_TESTS=y
BR2_PACKAGE_MEMTESTER=y
BR2_PACKAGE_NCURSES=y
BR2_PACKAGE_AVAHI=y
BR2_PACKAGE_AVAHI_DAEMON=y
BR2_PACKAGE_AVAHI_LIBDNSSD_COMPATIBILITY=y
BR2_PACKAGE_AVAHI_DEFAULT_SERVICES=y
BR2_PACKAGE_BRIDGE_UTILS=y
BR2_PACKAGE_DHCPCD=y
BR2_PACKAGE_DROPBEAR=y
BR2_PACKAGE_IPERF3=y
BR2_PACKAGE_MOSQUITTO=y
# BR2_PACKAGE_MOSQUITTO_BROKER is not set
BR2_PACKAGE_OPENSSH=y
BR2_PACKAGE_PHYTOOL=y
BR2_PACKAGE_SOCAT=y
BR2_PACKAGE_TCPDUMP=y
BR2_TARGET_ROOTFS_CPIO_GZIP=y
BR2_TARGET_ROOTFS_INITRAMFS=y
BR2_TARGET_UBOOT=y
BR2_TARGET_UBOOT_BUILD_SYSTEM_KCONFIG=y
BR2_TARGET_UBOOT_CUSTOM_VERSION=y
BR2_TARGET_UBOOT_CUSTOM_VERSION_VALUE="2023.04"
BR2_TARGET_UBOOT_USE_CUSTOM_CONFIG=y
BR2_TARGET_UBOOT_CUSTOM_CONFIG_FILE="$(BR2_EXTERNAL_QUT_PATH)/board/cosmos/uboot.config"
BR2_TARGET_UBOOT_NEEDS_DTC=y
BR2_TARGET_UBOOT_NEEDS_OPENSSL=y
# BR2_TARGET_UBOOT_FORMAT_BIN is not set
BR2_TARGET_UBOOT_FORMAT_REMAKE_ELF=y
BR2_TARGET_UBOOT_CUSTOM_MAKEOPTS="DEVICE_TREE=zynq-cosmos"
BR2_PACKAGE_HOST_DOSFSTOOLS=y
BR2_PACKAGE_HOST_E2FSPROGS=y
BR2_PACKAGE_HOST_GENIMAGE=y
BR2_PACKAGE_HOST_MTOOLS=y
BR2_PACKAGE_HOST_UBOOT_TOOLS_BOOT_SCRIPT=y
BR2_PACKAGE_HOST_UBOOT_TOOLS_BOOT_SCRIPT_SOURCE="$(BR2_EXTERNAL_QUT_PATH)/board/cosmos/uboot.cmd"
BR2_PACKAGE_BITSTREAM_TIMESTAMP=y
BR2_PACKAGE_CONFIGPL=y
BR2_PACKAGE_PHILICS_TELEMETRY=y
BR2_PACKAGE_COSMOS_I2CCONFIG=y
BR2_PACKAGE_PACPWM_CONFIG=y
BR2_PACKAGE_PHILICS_PL=y
BR2_PACKAGE_ZRPROC=y
BR2_PACKAGE_ZRPROC_FIRMWARE=y
BR2_PACKAGE_HOST_ZYNQ_MKBOOTIMAGE=y
BR2_PACKAGE_LINUXPTP=y
BR2_PACKAGE_ETHTOOL=y
BR2_PACKAGE_PLDRIFT=y
```

## br-external/package/philics-telemetry/Config.in
```kconfig
config BR2_PACKAGE_PHILICS_TELEMETRY
	bool "philics-telemetry"
	help
	  Telemetry streamer for PHiLICS Zynq OCM measurements (0xFFFFF000).
```

## br-external/package/pldrift/Config.in
```kconfig
config BR2_PACKAGE_PLDRIFT
	bool "pldrift"
	help
	  Logs the PL timestamp counter from the OCM ring buffer against
	  CLOCK_MONOTONIC_RAW and CLOCK_REALTIME for drift measurement.

	  Also installs adcmon (ADC monitor), ocmsoak, and adcburst, which
	  captures every 20 kHz sample for a fixed time into RAM and then
	  writes it to InfluxDB v2 as line protocol over HTTP.

	  adcscope streams a live lab view to InfluxDB: per-cycle RMS,
	  frequency and power, a block-averaged waveform, trip register
	  changes, and full-rate captures around trips or a manual trigger.
```
